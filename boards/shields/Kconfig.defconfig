## boards/shields/Kconfig.defconfig
```kconfig
if SHIELD_SWEEP_LEFT

# Name must be less than 16 characters long!
config ZMK_KEYBOARD_NAME
    default "sweep"

config ZMK_SPLIT_ROLE_CENTRAL
    default y

endif

if SHIELD_SWEEP_LEFT || SHIELD_SWEEP_RIGHT

config ZMK_SPLIT
    default y

endif
```

## boards/shields/splitkb_aurora_sweep/Kconfig.defconfig
```kconfig
if SHIELD_SPLITKB_AURORA_SWEEP_LEFT

# Name must be less than 16 characters long!
config ZMK_KEYBOARD_NAME
    default "splitkb_aurora_sweep"

config ZMK_SPLIT_ROLE_CENTRAL
    default y

endif

if SHIELD_SPLITKB_AURORA_SWEEP_LEFT || SHIELD_SPLITKB_AURORA_SWEEP_RIGHT

config ZMK_SPLIT
    default y

endif
```
